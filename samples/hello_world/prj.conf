## prj.conf
```kconfig
# nothing here
#
#
CONFIG_ETH_E1000E=n

# Should be identical to scpu since its just another app.
# 0x80000000 == begining of (simulated) ROM
# 0x80006c00 == begining of RAM
#
# Recogni bootloadloader sample app
#
CONFIG_ETH_E1000E=n
CONFIG_NETWORKING=n

#
# If looking for 'regular' hello_world behavior, comment out below lines.
# 
# Scorpio SRAM is 512K
# Current cofig uses 179K for Bootloader ROM/RAM
# SRAM_SIZE: 512K Total - 179K form bootloader leaves 333K for app
# SRAM_BASE_ADDR: App loads at 179K. 179K starting at 0x80000000 == 0x8002cc00
#
CONFIG_XIP=n
CONFIG_SRAM_SIZE=233
CONFIG_SRAM_BASE_ADDRESS=0x80045c00
CONFIG_BOOTLOADER_MCUBOOT=y  
```

## src/main.c
```c
/*
 * Copyright (c) 2012-2014 Wind River Systems, Inc.
 *
 * SPDX-License-Identifier: Apache-2.0
 */

#include <zephyr.h>
#include <sys/printk.h>
#include <pcie_recogni.h>
#include <drivers/pcie/pcie.h>
#include <sys/types.h>
#include <sys/device_mmio.h>
#include <drivers/pcie/pcie.h>

#define EP_DEV_VENDOR_ID  0x10c98086

void main(void)
{
	struct pcie_mbar mbar;
	pcie_bdf_t bdf = 0x100;
	mm_reg_t address;
	printk("Hello World! %s\n", CONFIG_BOARD);

    pcie_probe(0x100, EP_DEV_VENDOR_ID);

	pcie_get_mbar(bdf, 0, &mbar);
	pcie_set_cmd(bdf, PCIE_CONF_CMDSTAT_MEM |
			     PCIE_CONF_CMDSTAT_MASTER, true);

	device_map(&address, mbar.phys_addr, mbar.size, K_MEM_CACHE_NONE);

//	pcie_get_mbar(bdf, 1, &mbar);
//	pcie_get_mbar(bdf, 2, &mbar);
//	pcie_get_mbar(bdf, 3, &mbar);
//	pcie_get_mbar(bdf, 4, &mbar);
//	pcie_get_mbar(bdf, 4, &mbar);

	printk("0x%x\n", *(int *)address);

    printk("Done! %s\n", CONFIG_BOARD);

}
```
