## drivers/ethernet/Kconfig.lowRISC
```kconfig
# Copyright (c) Recogni


menuconfig ETH_LOWRISC
	bool "Low Risc Ethernet driver"
	help
	  Enable LowRISC Ethernet driver.

config ETH_NIC_MODEL
	string
	default "lowRISC"
	depends on ETH_LOWRISC
	help
	  Tells what Qemu network model to use. This value is given as
	  a parameter to -nic qemu command line option.
```
