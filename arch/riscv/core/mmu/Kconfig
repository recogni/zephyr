## arch/riscv/core/mmu/Kconfig
```kconfig
#
# Copyright (c) 2021 Recogni, Inc.
#
# SPDX-License-Identifier: Apache-2.0
#

config RISCV_MMU_DEBUG
	bool "Build with debugging of MMU initialization enabled, including an early unconditional ebreak after switching to supervisor mode"
	default n
```

## drivers/ethernet/Kconfig.scorpio_eth
```kconfig
menuconfig ETH_SCORPIO
	bool "Recogni Scorpio Built In Ethernet"
	depends on SOC_RISCV64_SCORPIO 
	help
	  Enable Recogni Scorpio Ethernet driver.

if ETH_SCORPIO

config ETH_SCORPIO_PHY_ADDR
	int "SCORPIO PHY Address"
	default 0
	help
	  SCORPIO PHY Address as used by IEEE 802.3, Section 2 MII compatible PHY
	  transceivers. If you have a single PHY on board it is safe to leave it
	  at 0 which is the broadcast address.


endif # ETH_SCORPIO
```

## modules/erpc/Kconfig
```kconfig
# Copyright (c) 2020 Linumiz
# SPDX-License-Identifier: Apache-2.0
#WTF_XYZ
config ZEPHYR_ERPC_MODULE
	bool

config ERPC
	bool "Enable rpc library"
	help
	  This option enables eprc library.
```
